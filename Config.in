## Config.in
```kconfig
source "$BR2_EXTERNAL_SL_BOX_PATH/package/baresip/Config.in"
source "$BR2_EXTERNAL_SL_BOX_PATH/package/libre/Config.in"
source "$BR2_EXTERNAL_SL_BOX_PATH/package/librem/Config.in"
source "$BR2_EXTERNAL_SL_BOX_PATH/package/sljack2/Config.in"
```

## configs/slbox_defconfig
```kconfig
BR2_arm=y
BR2_cortex_a8=y
BR2_GLOBAL_PATCH_DIR="$(BR2_EXTERNAL_SL_BOX_PATH)/board/beaglebone/patches"
BR2_TOOLCHAIN_EXTERNAL=y
BR2_PACKAGE_HOST_GDB=y
BR2_TARGET_GENERIC_GETTY_PORT="ttyO0"
BR2_SYSTEM_DHCP="eth0"
BR2_ROOTFS_OVERLAY="$(BR2_EXTERNAL_SL_BOX_PATH)/board/beaglebone/overlayfs"
BR2_ROOTFS_POST_IMAGE_SCRIPT="$(BR2_EXTERNAL_SL_BOX_PATH)/board/beaglebone/post-image.sh"
BR2_LINUX_KERNEL=y
BR2_LINUX_KERNEL_CUSTOM_VERSION=y
BR2_LINUX_KERNEL_CUSTOM_VERSION_VALUE="4.1.38"
BR2_LINUX_KERNEL_USE_CUSTOM_CONFIG=y
BR2_LINUX_KERNEL_CUSTOM_CONFIG_FILE="$(BR2_EXTERNAL_SL_BOX_PATH)/board/beaglebone/defconfig"
BR2_LINUX_KERNEL_DTS_SUPPORT=y
BR2_LINUX_KERNEL_INTREE_DTS_NAME="am335x-evm am335x-bone am335x-boneblack am335x-evmsk"
BR2_PACKAGE_ALSA_UTILS=y
BR2_PACKAGE_FLAC=y
BR2_PACKAGE_GDB=y
BR2_PACKAGE_AM33X_CM3=y
BR2_PACKAGE_OPUS=y
BR2_PACKAGE_OPUS_FIXED_POINT=y
BR2_PACKAGE_OPENSSL=y
BR2_PACKAGE_MXML=y
BR2_PACKAGE_DROPBEAR=y
BR2_PACKAGE_NGINX=y
BR2_TARGET_ROOTFS_EXT2=y
BR2_TARGET_ROOTFS_EXT2_4=y
BR2_TARGET_ROOTFS_EXT2_EXTRA_BLOCKS=32000
BR2_TARGET_UBOOT=y
BR2_TARGET_UBOOT_BUILD_SYSTEM_KCONFIG=y
BR2_TARGET_UBOOT_CUSTOM_VERSION=y
BR2_TARGET_UBOOT_CUSTOM_VERSION_VALUE="2016.09.01"
BR2_TARGET_UBOOT_BOARD_DEFCONFIG="am335x_evm"
BR2_TARGET_UBOOT_NEEDS_DTC=y
# BR2_TARGET_UBOOT_FORMAT_BIN is not set
BR2_TARGET_UBOOT_FORMAT_IMG=y
BR2_TARGET_UBOOT_FORMAT_CUSTOM=y
BR2_TARGET_UBOOT_FORMAT_CUSTOM_NAME="spl/u-boot-spl.bin"
BR2_TARGET_UBOOT_SPL=y
BR2_TARGET_UBOOT_SPL_NAME="MLO"
BR2_PACKAGE_HOST_DOSFSTOOLS=y
BR2_PACKAGE_HOST_GENIMAGE=y
BR2_PACKAGE_HOST_MTOOLS=y
BR2_PACKAGE_BARESIP=y
BR2_PACKAGE_LIBRE=y
BR2_PACKAGE_LIBREM=y
BR2_PACKAGE_SLJACK2=y
```

## package/baresip/Config.in
```kconfig
config BR2_PACKAGE_BARESIP
	bool "baresip"
	select BR2_PACKAGE_RE
	select BR2_PACKAGE_ZLIB
	select BR2_PACKAGE_XLIB_LIBXEXT if BR2_PACKAGE_XORG7
```

## package/libre/Config.in
```kconfig
config BR2_PACKAGE_LIBRE
	bool "re library"
	help
	  Toolkit library for asynchronous network IO
	  with protocol stacks including SIP, SDP, RTP,
	  STUN, TURN, ICE and DNS.

	  Warning: if you use uClibc, you must enable
	  UCLIBC_HAS_BSD_RES_CLOSE.
  
	  http://www.creytiv.com
```
